/**
 * These arguments were used when this file was generated. They will be automatically applied on subsequent loads
 * via the GUI or CLI. Run CLI with '--help' for additional information on how to override these arguments.
 * @cliArgs --device "F280015x" --part "F280015x_64PM" --package "64PM" --context "system" --product "powerSUITE@4.01.00.00"
 * @v2CliArgs --device "TMS320F2800157-Q1" --package "64PM" --context "system" --product "powerSUITE@4.01.00.00"
 * @versions {"tool":"1.25.0+4268"}
 */

/**
 * Import the modules used in this configuration.
 */
const TIDM_DC_DC_BUCK = scripting.addModule("/devkits/TIDM_DC_DC_BUCK/TIDM_DC_DC_BUCK");

/**
 * Write custom configuration values to the imported modules.
 */
TIDM_DC_DC_BUCK.IsrRatio = 2;
